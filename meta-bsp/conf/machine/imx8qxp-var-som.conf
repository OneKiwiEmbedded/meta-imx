## meta-bsp/conf/machine/imx8qxp-var-som.conf
```bitbake
#@TYPE: Machine
#@NAME: i.MX 8QXP LPDDR4 ARM2
#@DESCRIPTION: i.MX 8QXP LPDDR4 ARM2 Development board

MACHINE_NAME = "OneKiwi-iMX8X"

MACHINEOVERRIDES =. "mx8:mx8x:mx8qxp:"
#MACHINEOVERRIDES =. "imx8qxp-variscite:"

require conf/machine/include/imx-base.inc
require conf/machine/include/arm/armv8a/tune-cortexa35.inc

KERNEL_DEVICETREE_BASENAME = "imx8qxp-variscite"
#MACHINE_FEATURES += "soc-revb0"

# Don't include kernels in standard images
RDEPENDS:${KERNEL_PACKAGE_NAME}-base = ""
RDEPENDS:${KERNEL_PACKAGE_NAME}-image = ""

LOADADDR = ""

# Disable the serial console due to auto-serial-console
#SERIAL_CONSOLES = "115200;ttyAMA0"
SERIAL_CONSOLES = "115200;ttyLP3"

# we do not want to have getty running on tty1 as we run
# auto-serial-console there
USE_VT = "0"

KERNEL_DEVICETREE = " \
	freescale/imx8qxp-var-som.dtb \
	freescale/imx8qxp-var-som-sd.dtb \
	freescale/imx8qxp-var-som-wifi.dtb \
"

SPL_BINARY = "spl/u-boot-spl.bin"
UBOOT_SUFFIX = "bin"
#UBOOT_MAKE_TARGET = "u-boot.bin"
UBOOT_CONFIG ??= "sd"
UBOOT_CONFIG[sd] = "imx8qxp_var_som_defconfig,sdcard"
#UBOOT_CONFIG[fspi] = "imx8qxp_lpddr4_val_fspi_config"
#UBOOT_CONFIG[nand] = "imx8qxp_lpddr4_val_nand_config,ubifs"

# Set U-Boot DTB
#UBOOT_DTB_NAME = "imx8qxp-var-som-symphony.dtb"

ATF_PLATFORM = "imx8qx"

IMAGE_BOOTLOADER = "imx-boot"
IMX_BOOT_SEEK = "32"

IMXBOOT_TARGETS = "flash_spl"

IMX_BOOT_SOC_TARGET = "iMX8QX"

BOARD_TYPE = "imx8qxp-variscite"

IMAGE_FSTYPES += "wic"
CORE_IMAGE_EXTRA_INSTALL += "plymouth"
```
